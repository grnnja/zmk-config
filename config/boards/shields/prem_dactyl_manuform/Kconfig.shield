## config/boards/shields/prem_dactyl_manuform/Kconfig.shield
```kconfig
config SHIELD_PREM_DACTYL_MANUFORM_LEFT
	def_bool $(shields_list_contains,prem_dactyl_manuform_left)

config SHIELD_PREM_DACTYL_MANUFORM_RIGHT
	def_bool $(shields_list_contains,prem_dactyl_manuform_right)
```
