#include "prem_dactyl_manuform.dtsi"

&default_transform {
	col-offset = <7>;
};

&kscan0 {
	col-gpios
		= <&pro_micro_d 10 (GPIO_ACTIVE_HIGH | GPIO_PULL_DOWN)>
		, <&pro_micro_d 16 (GPIO_ACTIVE_HIGH | GPIO_PULL_DOWN)>
		, <&pro_micro_d 14 (GPIO_ACTIVE_HIGH | GPIO_PULL_DOWN)>
		, <&pro_micro_d 15 (GPIO_ACTIVE_HIGH | GPIO_PULL_DOWN)>
		, <&pro_micro_a  0 (GPIO_ACTIVE_HIGH | GPIO_PULL_DOWN)>
		, <&pro_micro_a  1 (GPIO_ACTIVE_HIGH | GPIO_PULL_DOWN)>
		, <&pro_micro_a  2 (GPIO_ACTIVE_HIGH | GPIO_PULL_DOWN)>
		;

		row-gpios
		= <&pro_micro_d 1 GPIO_ACTIVE_HIGH>
		, <&pro_micro_d 5 GPIO_ACTIVE_HIGH>
		, <&pro_micro_a 3 GPIO_ACTIVE_HIGH>
		, <&pro_micro_d 7 GPIO_ACTIVE_HIGH>
		, <&pro_micro_d 8 GPIO_ACTIVE_HIGH>
		, <&pro_micro_d 9 GPIO_ACTIVE_HIGH>
		;
};

&bt_unpair_combo {
	key-positions = <11 39>;
};
